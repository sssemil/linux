/* DO NOT EDIT - Automatically generated by python */
/ {
		SCUDATL_2850_39k_4400:SCUDATL_2850_39k_4400 {
			fcc = <2850>;
			default_rbatt_mohm = <100>;
			id_identify_min = <1235>;
			id_identify_max = <1759>;
			id_voltage_min = <1420>;
			id_voltage_max = <1562>;
			vbat_max = <4400>;
			temp_para = 
						"-32767","0","-1","0","4100","0",
						"0","5","-1","285","4400","0",
						"5","10","-1","855","4400","3",
						"10","45","-1","-1","4400","3",
						"45","50","-1","997","4400","3",
						"50","32767","-1","0","4400","0";
			vbat_para = 
						"-32767","3400","-1","820","0",
						"3400","32767","-1","-1","0";
			segment_para = 
						"-32767","4150","2850","4208","50",
						"4150","4450","1995","4400","0";
			batt_brand = "SCUDATL";
			fcc_temp = <2823 2825 2819 2832 2821 2810>;
			fcc_sf_x = <0 100 200 300 400 500>;
			fcc_sf_y = <100 96 94 92 90 88>;
			fcc_sf_cols = <6>;
			pc_sf_rows = <1>;
			pc_sf_cols = <1>;
			pc_sf_row_entries = <0>;
			pc_sf_percent = <100>;
			pc_sf_sf = <100>;
			rbatt_sf_rows = <28>;
			rbatt_sf_cols = <6>;
			rbatt_sf_percent = <100 95 90 85 80 75 70 65 60 55 50 45 40 35 30 25 20 15 10 9 8 7 6 5 4 3 2 1>;
			rbatt_sf_sf = <
			               2574 1259 838 165 118 99
			               2574 1259 838 165 118 99
			               2430 1254 832 166 119 100
			               2284 1234 825 168 122 101
			               2226 1217 834 175 125 104
			               2110 1224 865 183 131 107
			               1990 1118 790 194 136 110
			               1986 1122 763 210 146 116
			               1961 1112 740 198 159 123
			               1968 1105 730 160 122 103
			               1998 1119 727 157 117 100
			               2045 1164 761 160 119 102
			               2102 1226 821 168 124 105
			               2176 1300 894 172 131 111
			               2270 1378 978 171 129 105
			               2378 1487 1090 165 120 102
			               2528 1596 1216 167 120 102
			               2731 1748 1388 172 123 103
			               3039 2019 1646 184 125 105
			               3456 1967 1611 182 126 106
			               4395 1904 1251 178 127 108
			               4733 2121 1414 177 126 107
			               4957 2346 1615 175 125 106
			               5272 2591 1870 174 123 103
			               5546 2871 2125 178 123 104
			               5712 3242 2465 186 127 106
			               5896 3806 2918 212 131 108
			               6826 4815 3750 469 162 113
			              >;
			pc_temp_ocv_rows = <29>;
			pc_temp_ocv_cols = <6>;
			pc_temp_ocv_percent = <100 95 90 85 80 75 70 65 60 55 50 45 40 35 30 25 20 15 10 9 8 7 6 5 4 3 2 1>;
			pc_temp_ocv_ocv = <
			                   4357 4356 4351 4345 4337 4331
			                   4260 4275 4273 4284 4278 4273
			                   4193 4212 4211 4227 4221 4216
			                   4130 4154 4153 4171 4165 4162
			                   4083 4102 4101 4118 4112 4109
			                   4021 4051 4056 4069 4062 4059
			                   3951 3974 3988 4018 4014 4012
			                   3911 3933 3940 3974 3973 3971
			                   3871 3893 3896 3926 3929 3927
			                   3842 3856 3858 3876 3877 3877
			                   3820 3826 3825 3846 3847 3847
			                   3802 3807 3805 3823 3824 3823
			                   3786 3792 3793 3804 3805 3803
			                   3771 3781 3783 3787 3789 3788
			                   3758 3767 3772 3772 3771 3765
			                   3744 3756 3762 3755 3749 3739
			                   3729 3738 3744 3737 3731 3718
			                   3710 3718 3717 3709 3705 3692
			                   3678 3699 3694 3688 3684 3673
			                   3672 3694 3689 3686 3681 3670
			                   3667 3687 3682 3684 3679 3668
			                   3659 3680 3676 3681 3677 3665
			                   3645 3671 3668 3672 3671 3659
			                   3630 3657 3653 3645 3654 3638
			                   3606 3630 3622 3601 3616 3599
			                   3567 3585 3573 3542 3564 3548
			                   3504 3517 3502 3460 3494 3482
			                   3402 3412 3396 3338 3389 3383
			                   3200 3200 3200 3200 3200 3200
			                  >;
		};
};

/* DO NOT EDIT - Automatically generated by python */
/ {
		SCUDLG_3240_200k_4400:SCUDLG_3240_200k_4400 {
			fcc = <3240>;
			default_rbatt_mohm = <100>;
			id_identify_min = <2786>;
			id_identify_max = <3312>;
			id_voltage_min = <2941>;
			id_voltage_max = <3167>;
			vbat_max = <4400>;
			temp_para = 
						"-32767","0","-1","0","4100","0",
						"0","5","-1","324","4400","0",
						"5","10","-1","972","4400","3",
						"10","45","-1","-1","4400","3",
						"45","50","-1","1134","4400","3",
						"50","32767","-1","0","4400","0";
			vbat_para = 
						"-32767","3400","-1","820","0",
						"3400","32767","-1","-1","0";
			segment_para = 
						"-32767","4150","3240","4208","50",
						"4150","4450","2268","4400","0";
			batt_brand = "SCUDLG";
			fcc_temp = <3280 3285 3287 3304 3271 3261>;
			fcc_sf_x = <0 100 200 300 400 500>;
			fcc_sf_y = <100 96 94 92 90 88>;
			fcc_sf_cols = <6>;
			pc_sf_rows = <1>;
			pc_sf_cols = <1>;
			pc_sf_row_entries = <0>;
			pc_sf_percent = <100>;
			pc_sf_sf = <100>;
			rbatt_sf_rows = <28>;
			rbatt_sf_cols = <6>;
			rbatt_sf_percent = <100 95 90 85 80 75 70 65 60 55 50 45 40 35 30 25 20 15 10 9 8 7 6 5 4 3 2 1>;
			rbatt_sf_sf = <
			               2038 931 455 124 93 79
			               2036 931 455 124 93 79
			               1925 932 463 126 93 79
			               1785 933 466 129 95 80
			               1785 919 476 134 98 81
			               1651 950 505 142 101 83
			               1566 837 465 152 106 86
			               1559 827 437 166 113 90
			               1541 841 437 173 124 95
			               1549 828 429 142 114 92
			               1605 819 420 124 95 80
			               1709 830 413 125 94 80
			               1836 885 414 128 96 83
			               1962 983 442 130 100 85
			               2081 1106 489 130 102 87
			               2202 1242 553 130 92 78
			               2348 1397 627 132 92 77
			               2535 1600 746 135 94 79
			               4310 1679 655 128 97 80
			               4853 1896 706 130 93 79
			               5341 2148 767 132 96 79
			               5816 2398 865 139 93 81
			               6348 2740 982 142 98 84
			               6946 3080 1108 143 97 84
			               7612 3399 1249 150 99 84
			               8382 3799 1445 176 107 86
			               9212 4352 1787 340 116 86
			               10285 5066 2329 801 176 141
			              >;
			pc_temp_ocv_rows = <29>;
			pc_temp_ocv_cols = <6>;
			pc_temp_ocv_percent = <100 95 90 85 80 75 70 65 60 55 50 45 40 35 30 25 20 15 10 9 8 7 6 5 4 3 2 1>;
			pc_temp_ocv_ocv = <
			                   4380 4379 4376 4364 4354 4349
			                   4252 4281 4285 4287 4280 4277
			                   4185 4214 4224 4227 4221 4218
			                   4114 4157 4166 4170 4164 4162
			                   4079 4096 4113 4116 4110 4108
			                   4003 4052 4065 4065 4060 4057
			                   3935 3971 3993 4011 4011 4010
			                   3892 3926 3942 3971 3970 3968
			                   3850 3891 3906 3930 3931 3929
			                   3818 3854 3870 3881 3884 3883
			                   3799 3820 3837 3845 3845 3844
			                   3785 3795 3810 3820 3820 3819
			                   3771 3778 3789 3801 3801 3800
			                   3758 3766 3778 3785 3786 3784
			                   3747 3755 3768 3772 3771 3768
			                   3734 3744 3755 3759 3752 3739
			                   3720 3732 3738 3740 3732 3718
			                   3702 3717 3717 3713 3707 3694
			                   3673 3695 3694 3688 3681 3669
			                   3666 3688 3689 3686 3679 3667
			                   3658 3681 3684 3684 3678 3666
			                   3647 3672 3679 3681 3675 3663
			                   3633 3664 3671 3674 3671 3658
			                   3615 3651 3656 3653 3657 3639
			                   3593 3625 3626 3610 3623 3602
			                   3561 3584 3578 3552 3573 3551
			                   3506 3521 3510 3480 3505 3481
			                   3410 3422 3412 3391 3408 3383
			                   3200 3200 3200 3200 3200 3200
			                  >;
		};
};

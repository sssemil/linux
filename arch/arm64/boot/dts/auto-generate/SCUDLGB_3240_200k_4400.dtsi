/* DO NOT EDIT - Automatically generated by python */
/ {
		SCUDLGB_3240_200k_4400:SCUDLGB_3240_200k_4400 {
			fcc = <3240>;
			default_rbatt_mohm = <100>;
			id_identify_min = <2786>;
			id_identify_max = <3312>;
			id_voltage_min = <2941>;
			id_voltage_max = <3167>;
			vbat_max = <4400>;
			temp_para = 
						"-32767","0","-1","0","4100","0",
						"0","5","-1","324","4400","0",
						"5","10","-1","972","4400","3",
						"10","45","-1","-1","4400","3",
						"45","50","-1","1134","4400","3",
						"50","32767","-1","0","4400","0";
			vbat_para = 
						"-32767","3400","-1","820","0",
						"3400","32767","-1","-1","0";
			segment_para = 
						"-32767","4150","3240","4208","50",
						"4150","4450","2268","4400","0";
			batt_brand = "SCUDLGB";
			fcc_temp = <3266 3240 3237 3248 3241 3226>;
			fcc_sf_x = <0 100 200 300 400 500>;
			fcc_sf_y = <100 96 94 92 90 88>;
			fcc_sf_cols = <6>;
			pc_sf_rows = <1>;
			pc_sf_cols = <1>;
			pc_sf_row_entries = <0>;
			pc_sf_percent = <100>;
			pc_sf_sf = <100>;
			rbatt_sf_rows = <28>;
			rbatt_sf_cols = <6>;
			rbatt_sf_percent = <100 95 90 85 80 75 70 65 60 55 50 45 40 35 30 25 20 15 10 9 8 7 6 5 4 3 2 1>;
			rbatt_sf_sf = <
			               1929 1152 537 127 90 76
			               1928 1152 537 127 90 76
			               1856 1136 549 123 91 76
			               1766 1109 559 126 94 77
			               1760 1099 572 130 96 79
			               1598 1052 613 143 100 80
			               1536 930 518 144 104 84
			               1526 944 521 159 111 87
			               1490 924 506 170 123 92
			               1517 903 483 135 107 84
			               1593 922 474 121 92 77
			               1709 988 461 121 92 77
			               1851 1094 500 125 94 79
			               1992 1223 572 128 99 83
			               2121 1344 674 127 101 84
			               2249 1463 788 129 89 75
			               2389 1586 910 129 90 76
			               2571 1724 1066 136 93 77
			               4315 1899 1243 141 95 80
			               5122 2013 948 137 94 80
			               5727 2302 1086 138 93 78
			               6331 2655 1262 139 94 79
			               7032 3019 1412 141 98 79
			               7667 3362 1629 145 96 79
			               8410 3703 1821 150 98 82
			               9171 4161 2001 160 101 84
			               10012 4737 2398 191 112 85
			               11175 5590 2907 334 165 137
			              >;
			pc_temp_ocv_rows = <29>;
			pc_temp_ocv_cols = <6>;
			pc_temp_ocv_percent = <100 95 90 85 80 75 70 65 60 55 50 45 40 35 30 25 20 15 10 9 8 7 6 5 4 3 2 1>;
			pc_temp_ocv_ocv = <
			                   4363 4355 4352 4342 4338 4332
			                   4240 4256 4265 4271 4268 4264
			                   4171 4190 4202 4211 4210 4207
			                   4106 4132 4149 4156 4155 4151
			                   4067 4085 4095 4102 4102 4098
			                   3982 4028 4050 4058 4053 4049
			                   3925 3951 3975 3998 4004 4003
			                   3883 3914 3937 3965 3966 3962
			                   3838 3873 3896 3925 3927 3924
			                   3812 3834 3857 3874 3878 3876
			                   3796 3809 3825 3840 3841 3840
			                   3782 3795 3799 3817 3818 3816
			                   3768 3782 3788 3799 3799 3797
			                   3757 3771 3779 3784 3785 3782
			                   3745 3758 3769 3772 3771 3767
			                   3733 3747 3758 3760 3752 3739
			                   3719 3734 3740 3742 3733 3719
			                   3702 3718 3717 3715 3706 3692
			                   3673 3699 3695 3687 3680 3669
			                   3667 3692 3686 3686 3679 3667
			                   3660 3684 3680 3684 3678 3666
			                   3649 3677 3675 3682 3675 3663
			                   3637 3670 3666 3677 3670 3657
			                   3617 3657 3652 3662 3656 3638
			                   3593 3631 3626 3629 3622 3601
			                   3560 3587 3581 3577 3572 3550
			                   3509 3522 3519 3508 3506 3481
			                   3414 3424 3423 3413 3409 3383
			                   3200 3200 3200 3200 3200 3200
			                  >;
		};
};

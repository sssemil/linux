/* DO NOT EDIT - Automatically generated by python */
/ {
		SCUDGYB_3240_22k_4400:SCUDGYB_3240_22k_4400 {
			fcc = <3240>;
			default_rbatt_mohm = <100>;
			id_identify_min = <751>;
			id_identify_max = <1235>;
			id_voltage_min = <949>;
			id_voltage_max = <1051>;
			vbat_max = <4400>;
			temp_para = 
						"-32767","0","-1","0","4100","0",
						"0","5","-1","324","4400","0",
						"5","10","-1","972","4400","3",
						"10","45","-1","-1","4400","3",
						"45","50","-1","1134","4400","3",
						"50","32767","-1","0","4400","0";
			vbat_para = 
						"-32767","3400","-1","820","0",
						"3400","32767","-1","-1","0";
			segment_para = 
						"-32767","4150","3240","4208","50",
						"4150","4450","2268","4400","0";
			batt_brand = "SCUDGYB";
			fcc_temp = <3196 3185 3185 3196 3192 3166>;
			fcc_sf_x = <0 100 200 300 400 500>;
			fcc_sf_y = <100 96 94 92 90 88>;
			fcc_sf_cols = <6>;
			pc_sf_rows = <1>;
			pc_sf_cols = <1>;
			pc_sf_row_entries = <0>;
			pc_sf_percent = <100>;
			pc_sf_sf = <100>;
			rbatt_sf_rows = <28>;
			rbatt_sf_cols = <6>;
			rbatt_sf_percent = <100 95 90 85 80 75 70 65 60 55 50 45 40 35 30 25 20 15 10 9 8 7 6 5 4 3 2 1>;
			rbatt_sf_sf = <
			               1575 648 317 124 105 99
			               1575 648 317 124 105 99
			               1530 649 321 120 105 100
			               1443 655 328 123 107 100
			               1457 653 334 125 109 101
			               1371 739 374 131 112 103
			               1227 617 364 136 115 106
			               1231 606 338 153 125 111
			               1205 602 322 147 126 110
			               1204 592 303 124 110 103
			               1225 594 301 119 106 101
			               1262 611 299 120 107 101
			               1320 646 305 124 109 103
			               1406 702 315 129 114 106
			               1518 779 334 129 112 103
			               1650 885 364 122 106 101
			               1808 1029 406 123 107 103
			               2011 1243 470 125 108 102
			               2289 1600 600 130 111 108
			               2347 1679 630 131 112 110
			               2434 1251 503 133 116 113
			               2918 1234 487 132 114 113
			               3301 1406 537 131 110 107
			               3698 1588 552 125 109 104
			               4168 1741 571 128 109 105
			               4655 1914 618 130 111 106
			               5372 2308 670 135 113 105
			               6359 2866 845 150 120 111
			              >;
			pc_temp_ocv_rows = <29>;
			pc_temp_ocv_cols = <6>;
			pc_temp_ocv_percent = <100 95 90 85 80 75 70 65 60 55 50 45 40 35 30 25 20 15 10 9 8 7 6 5 4 3 2 1>;
			pc_temp_ocv_ocv = <
			                   4368 4363 4360 4353 4349 4342
			                   4279 4290 4292 4294 4290 4285
			                   4214 4229 4234 4235 4233 4228
			                   4147 4174 4180 4179 4177 4172
			                   4109 4119 4126 4125 4123 4119
			                   4044 4085 4086 4074 4072 4067
			                   3957 3992 4013 4019 4022 4020
			                   3919 3942 3958 3978 3980 3977
			                   3877 3901 3916 3928 3929 3927
			                   3843 3863 3876 3881 3882 3881
			                   3821 3832 3845 3850 3850 3849
			                   3806 3810 3820 3826 3825 3825
			                   3794 3797 3800 3806 3806 3804
			                   3783 3788 3787 3790 3789 3787
			                   3770 3778 3778 3774 3769 3761
			                   3755 3766 3768 3755 3747 3735
			                   3740 3748 3750 3737 3727 3713
			                   3724 3724 3722 3710 3700 3686
			                   3701 3703 3701 3691 3683 3670
			                   3696 3699 3697 3688 3680 3668
			                   3685 3693 3692 3686 3677 3666
			                   3675 3685 3687 3683 3674 3661
			                   3661 3673 3678 3675 3665 3649
			                   3639 3653 3656 3651 3638 3622
			                   3606 3619 3618 3610 3597 3581
			                   3556 3566 3565 3557 3545 3529
			                   3488 3496 3494 3488 3477 3462
			                   3388 3392 3393 3388 3378 3366
			                   3200 3200 3200 3200 3200 3200
			                  >;
		};
};

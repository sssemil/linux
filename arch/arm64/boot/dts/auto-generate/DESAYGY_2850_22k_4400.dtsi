/* DO NOT EDIT - Automatically generated by python */
/ {
		DESAYGY_2850_22k_4400:DESAYGY_2850_22k_4400 {
			fcc = <2850>;
			default_rbatt_mohm = <100>;
			id_identify_min = <751>;
			id_identify_max = <1235>;
			id_voltage_min = <949>;
			id_voltage_max = <1051>;
			vbat_max = <4400>;
			temp_para = 
						"-32767","0","-1","0","4100","0",
						"0","5","-1","285","4400","0",
						"5","10","-1","855","4400","3",
						"10","45","-1","-1","4400","3",
						"45","50","-1","997","4400","3",
						"50","32767","-1","0","4400","0";
			vbat_para = 
						"-32767","3400","-1","820","0",
						"3400","32767","-1","-1","0";
			segment_para = 
						"-32767","4150","2850","4208","50",
						"4150","4450","1995","4400","0";
			batt_brand = "DESAYGY";
			fcc_temp = <2840 2844 2841 2847 2842 2824>;
			fcc_sf_x = <0 100 200 300 400 500>;
			fcc_sf_y = <100 96 94 92 90 88>;
			fcc_sf_cols = <6>;
			pc_sf_rows = <1>;
			pc_sf_cols = <1>;
			pc_sf_row_entries = <0>;
			pc_sf_percent = <100>;
			pc_sf_sf = <100>;
			rbatt_sf_rows = <28>;
			rbatt_sf_cols = <6>;
			rbatt_sf_percent = <100 95 90 85 80 75 70 65 60 55 50 45 40 35 30 25 20 15 10 9 8 7 6 5 4 3 2 1>;
			rbatt_sf_sf = <
			               1819 731 439 132 108 98
			               1818 731 439 132 108 98
			               1783 734 439 133 109 98
			               1713 739 443 135 111 99
			               1733 731 448 138 112 100
			               1666 813 516 143 115 102
			               1490 689 468 149 119 105
			               1505 675 432 170 128 109
			               1488 675 416 165 141 116
			               1487 665 397 131 111 101
			               1508 668 389 128 108 99
			               1550 681 391 130 108 99
			               1610 708 400 135 112 102
			               1698 749 422 138 117 106
			               1812 803 456 137 116 101
			               1940 890 515 129 107 99
			               2097 982 585 130 107 100
			               2294 1101 689 134 110 101
			               2616 1241 798 138 112 102
			               2907 1092 629 138 113 106
			               3166 1149 640 137 112 107
			               3292 1236 693 139 113 105
			               3432 1332 769 136 110 105
			               3500 1413 841 139 109 103
			               3424 1473 899 139 110 103
			               3244 1577 970 152 112 102
			               3281 1797 1148 216 126 109
			               3699 2253 1497 611 228 164
			              >;
			pc_temp_ocv_rows = <29>;
			pc_temp_ocv_cols = <6>;
			pc_temp_ocv_percent = <100 95 90 85 80 75 70 65 60 55 50 45 40 35 30 25 20 15 10 9 8 7 6 5 4 3 2 1>;
			pc_temp_ocv_ocv = <
			                   4363 4361 4357 4351 4346 4339
			                   4275 4284 4286 4290 4285 4280
			                   4209 4224 4227 4233 4228 4223
			                   4147 4170 4171 4177 4172 4167
			                   4106 4117 4119 4124 4118 4114
			                   4047 4079 4082 4073 4067 4064
			                   3955 3987 4004 4019 4018 4016
			                   3917 3938 3950 3978 3977 3974
			                   3877 3901 3908 3929 3932 3929
			                   3845 3865 3870 3878 3878 3878
			                   3823 3835 3838 3848 3847 3847
			                   3808 3812 3813 3825 3824 3823
			                   3796 3797 3796 3806 3805 3803
			                   3783 3787 3787 3789 3789 3787
			                   3771 3777 3778 3773 3770 3763
			                   3756 3766 3768 3754 3747 3735
			                   3741 3747 3749 3736 3728 3715
			                   3725 3722 3722 3708 3702 3688
			                   3701 3705 3698 3688 3681 3670
			                   3694 3700 3694 3687 3679 3668
			                   3686 3696 3690 3684 3678 3666
			                   3675 3690 3684 3680 3674 3662
			                   3661 3680 3674 3667 3666 3652
			                   3641 3660 3653 3635 3639 3623
			                   3610 3624 3616 3589 3597 3582
			                   3564 3571 3563 3530 3544 3530
			                   3496 3500 3492 3453 3473 3461
			                   3397 3398 3395 3353 3374 3363
			                   3200 3200 3200 3200 3200 3200
			                  >;
		};
};

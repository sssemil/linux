## drivers/contexthub/flp/Kconfig
```kconfig
#
# FLP driver configuration
#

menu "HISI FLP configuration"

config HISI_FLP
	bool "HISI FLP support"
	depends on HISI_SYSCOUNTER && INPUTHUB
	default n
	---help---
	  Enable support for FLP driver

endmenu
```

## drivers/cpufreq/hisi/Kconfig.arm
```kconfig
config ARCH_HISI_MAXFREQ
	bool "Hisilicon platform cpu max freq recognition"
	depends on PM_OPP
	default n
	help
	  Hisilicon platform cpu max freq recognition.

config HISI_ENABLE_GET_VAL
	bool "Hisilicon get cpufreq param"
	default n
	help
	  Hisilicon get cpufreq param.

config HISI_ENABLE_HPM_DATA_COLLECT
	bool "Hisilicon get hpm volt param"
	depends on HISI_ENABLE_GET_VAL
	default n
	help
	  Hisilicon get avs hpm volt param.

config HISI_BIG_MAXFREQ_HOTPLUG
	tristate "Specific flow for Hisilicon Platform CPUfreq driver"
	depends on ARM_BIG_LITTLE_CPUFREQ && HOTPLUG_CPU
	help
	  This add Hotplug Flow in CPUfreq for Hisilicon Big-little Platform with boost freq.

config HISI_CPUFREQ_DT
	bool "Hisilicon cpufreq-dt enable"
	depends on CPUFREQ_DT
	default n
	help
	  Hisilicon cpufreq-dt enable.
```

## drivers/media/huawei/camera/platform/hi6250/Kconfig
```kconfig
comment "Huawei Sensor hi6250"

source "drivers/media/huawei/camera/sensor/vcm/Kconfig"
source "drivers/media/huawei/camera/sensor/flash/Kconfig"
source "drivers/media/huawei/camera/sensor/ois/Kconfig"

config HUAWEI_CAMERA_USE_IMX214
	bool "imx214"
    default y
	depends on HUAWEI_CAMERA

config HUAWEI_CAMERA_USE_IMX219
	bool "imx219"
    default y
	depends on HUAWEI_CAMERA

config HUAWEI_CAMERA_USE_IMX219BLN
	bool "imx219BLN"
    default y
	depends on HUAWEI_CAMERA

config HUAWEI_CAMERA_USE_IMX219BND
	bool "imx219BND"
    default y
	depends on HUAWEI_CAMERA

config HUAWEI_CAMERA_USE_OV13850
	bool "ov13850"
    default y
	depends on HUAWEI_CAMERA

config HUAWEI_CAMERA_USE_OV8856
	bool "ov8856"
    default y
	depends on HUAWEI_CAMERA

config HUAWEI_CAMERA_USE_OV8856BND
	bool "ov8856BND"
    default y
	depends on HUAWEI_CAMERA

config HUAWEI_CAMERA_USE_OV2680
	bool "ov2680"
    default y
	depends on HUAWEI_CAMERA
	
config HUAWEI_CAMERA_USE_GC2355
	bool "gc2355"
    default y
	depends on HUAWEI_CAMERA

config HUAWEI_CAMERA_USE_GC2375BND
	bool "gc2375BND"
    default y
	depends on HUAWEI_CAMERA

config HUAWEI_CAMERA_USE_HI259
        bool "hi259"
    default y
        depends on HUAWEI_CAMERA

config HUAWEI_CAMERA_USE_HI259BND
        bool "hi259BND"
    default y
        depends on HUAWEI_CAMERA

config HUAWEI_CAMERA_USE_HI843
	bool "hi843"
    default y
	depends on HUAWEI_CAMERA

config HUAWEI_CAMERA_USE_HI843BLN
	bool "hi843BLN"
    default y
	depends on HUAWEI_CAMERA

config HUAWEI_CAMERA_USE_HI843BND
	bool "hi843BND"
    default y
	depends on HUAWEI_CAMERA

config HUAWEI_CAMERA_USE_T4KA3
	bool "t4ka3"
    default y
	depends on HUAWEI_CAMERA

config HUAWEI_CAMERA_USE_AR1335
	bool "ar1335"
    default y
	depends on HUAWEI_CAMERA
	
config HUAWEI_CAMERA_USE_IMX386
	bool "imx386"
    default y
	depends on HUAWEI_CAMERA

config HUAWEI_CAMERA_USE_OV12870
        bool "ov12870"
    default y
        depends on HUAWEI_CAMERA

config HUAWEI_CAMERA_USE_IMX386E3
	bool "imx386E3"
    default n
	depends on HUAWEI_CAMERA

config HUAWEI_CAMERA_USE_OV12870E3
        bool "ov12870E3"
    default n
        depends on HUAWEI_CAMERA

config HUAWEI_CAMERA_USE_OV12A10
        bool "ov12a10"
    default y
        depends on HUAWEI_CAMERA

config HUAWEI_CAMERA_USE_IMX486
	bool "imx486"
    default y
	depends on HUAWEI_CAMERA

config HUAWEI_CAMERA_USE_IMX486PIC
        bool "imx486PIC"
    default n
        depends on HUAWEI_CAMERA

config HUAWEI_CAMERA_USE_OV12A10PIC
        bool "ov12a10PIC"
    default n
        depends on HUAWEI_CAMERA

config HUAWEI_CAMERA_USE_OV12A10HYBIRD
        bool "ov12a10hybird"
    default n
        depends on HUAWEI_CAMERA

config HUAWEI_CAMERA_USE_OV20880
        bool "ov20880"
    default n
        depends on HUAWEI_CAMERA

config HUAWEI_CAMERA_USE_OV20880BAC
        bool "ov20880BAC"
    default n
        depends on HUAWEI_CAMERA

config HUAWEI_CAMERA_USE_IMX376
        bool "imx376"
    default n
        depends on HUAWEI_CAMERA

config HUAWEI_CAMERA_USE_IMX376BAC
        bool "imx376BAC"
    default n
        depends on HUAWEI_CAMERA

config HUAWEI_CAMERA_USE_IMX486HYBIRD
        bool "imx486hybird"
    default n
        depends on HUAWEI_CAMERA

config HUAWEI_CAMERA_USE_OV8858
        bool "ov8858"
    default n
        depends on HUAWEI_CAMERA

config HUAWEI_CAMERA_USE_IMX219HDN
        bool "imx219HDN"
    default n
        depends on HUAWEI_CAMERA

config HUAWEI_CAMERA_USE_IMX219HDN_BACK
        bool "imx219HDN_BACK"
    default n
        depends on HUAWEI_CAMERA

config HUAWEI_CAMERA_USE_IMX298
	bool "imx298"
    default y
	depends on HUAWEI_CAMERA
```
